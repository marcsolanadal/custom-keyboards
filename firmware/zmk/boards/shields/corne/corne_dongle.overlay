#include "corne.dtsi"

/ {
    chosen {
        zmk,kscan = &mock_kscan;
        zmk,matrix-transform = &five_column_transform;
    };

    mock_kscan: kscan_0 {
        compatible = "zmk,kscan-mock";
        columns = <0>;
        rows = <0>;
        events = <0>;
    };
};
